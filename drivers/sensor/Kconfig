## drivers/sensor/Kconfig
```kconfig
# Copyright (c) 2021 Nordic Semiconductor ASA
# SPDX-License-Identifier: Apache-2.0

if SENSOR
rsource "example_sensor/Kconfig"
rsource "bme68x_iaq/Kconfig"
endif # SENSOR
```

## west.yml
```yaml
# Copyright (c) 2021 Nordic Semiconductor ASA
# SPDX-License-Identifier: Apache-2.0

manifest:
  self:
    west-commands: scripts/west-commands.yml

  defaults:
    remote: origin

  remotes:
    - name: origin
      url-base: git@github.com:dipakgmx

    - name: upstream
      url-base: git@github.com:zephyrproject-rtos

  projects:
    - name: zephyr
      remote: origin
      revision: main
      import:
        # By using name-allowlist we can clone only the modules that are
        # strictly needed by the application.
        name-allowlist:
          - cmsis_6    # required by the ARM port for Cortex-M
          - hal_nordic # required by the custom_plank board (Nordic based)
          - hal_nxp
          - hal_stm32  # required by the nucleo_f302r8 board (STM32 based)
          - littlefs
          - mbedtls
          - mcumgr
          - segger
          - zcbor
```
